


                                                                      
                                                            /* CODE FOR WATER MONITORING AND QUALITY UNIT 
                                                                DEPTH, TURBIDITY, pH and TEMPERATURE */


                                             


                    // IMPORTING LIBRARIES
            
#include<LiquidCrystal.h>      // LIBRARY FOR THE LCD DISPLAY
#include<DallasTemperature.h>  // LIBRARY FOR DS18B20 TEMPERATURE SENSOR
#include<OneWire.h>            // LIBRARY FOR DS18B20 TEMPERATURE SENSOR





                    // DEFINING VARIABLES

// 1. DEFINING VARIABLES FOR LCD DISPLAY

int RS=6;
int E=7;
int D4=5;
int D5=4;
int D6=3;
int D7=2;


// 2. DEFINING VARIABLES FOR ULTRASONIC SENSOR

int   trigpin=8;    // CONNECING THE TRIGGER PIN OF ULTRASONIC SENSOR WITH PIN 8 OF ARDUINO BOARD
int   echopin=9;    // CONNECING THE ECHO PIN OF ULTRASONIC SENSOR WITH PIN 9 OF ARDUINO BOARD
float pulsetime;    // DEFINE A VARIABLE TO STORE THE TIME OF THE PULSE GENERATED BY THE TRIGGER PIN
float depth;        // VARIABLE TO STORE THE DEPTH VALUES OF THE WATER LEVEL
int USLED = A2;     // AN LED THAT WILL TURN ON TO DISPLAY EXTREME VALUES OF DEPTH

// 3. DEFINING VARIABLES FOR PH SENSOR


int   pH=A0;        // DEFINING THE PIN WHICH WILL READ ANALOG VALUES FROM THE PH SENSOR
float array1[50];   // CREATES AN ARRAY OBJECT THAT WILL BE USED IN CALCULATION FOR THE AVERAGE VALUE OF PH
float avgvalue;     // VARIABLE FOR STORING THE AVERAGE VALUE
float convertor;    // CONVERTS THE ANALOG RESPONSE INTO 0-5V RANGE
float pHvalue;      // VARIABLE FOR STORING THE FINAL PH VALUE
int PHLED=11;       // AN LED THAT WILL TURN ON WHEN PH VALUES IS NOT WITHIN A SPECIFIC RANGE


// 4. DEFINING VARIABLES FOR TEMPERATURE SENSOR

float tempvalue;    // THE VARIABLE THAT WILL STORE THE TEMPERATURE VALUE IN CELCIUS
int TEMPLED=12;     // AN LED THAT WILL TURN ON WHEN THE TEMPERATURE VALUES IS NOT WITHIN A SPECIFIC RANGE


// 5. DEFINING VARIABLES FOR TURBIDITY SENSOR

int turbid=A1;       // DEFINING THE PIN WHICH WILL READ ANALOG VALUES FROM THE TURBIDITY SENSOR
float array2[5];     // THE VARIABLE THAT WILL STORE THE VALUES FOR ANALOG INPUT TURBIDITY VALUES
int TURBLED = A3;    // AN LED THAT WILL TURN ON WHEN THE TURBIDITY VALUES ARE ABOVE 5000 NTUs




                    // MAKING OBJECTS
                    

// 1. OBJECTS FOR LCD DISPLAY

LiquidCrystal LCD(RS,E,D4,D5,D6,D7);  // CREATING A LIQUID CRYSTAL OBJECT NAMED AS LCD



// 2. OBJECTS FOR TEMPERATURE SENSOR

#define temppin 10                      // DEFINE THE ANALOG PIN WHICH READS VALUE FOR THE TEMPERATURE SENSOR
OneWire oneWire(temppin);               // SETUP A ONEWIRE INSTANCE TO COMMUNICATE WITH ANY ONEWIRE DEVICES
DallasTemperature sensors(&oneWire);    // PASS THE ONEWIRE REFERENCE TO DALLAS TEMPERATURE




void setup() {

Serial.begin(57600);      // INITIALIZING THE SERIAL COMMUNICATION AND SETTING THE BAUD RATE TO 57600


LCD.begin(16,2);          // SEND SIGNAL TO ARDUINO TO START YOUR LCD WITH 16 COLUMNS AND 2 ROWS


pinMode(trigpin,OUTPUT);  // SETTING THE TRIGGER PIN TO THE OUTPUT STATE
pinMode(echopin,INPUT);   // SETTING THE ECHO PIN TO THE INPUT STATE


pinMode(pH,INPUT);        // SETTING THE ANALOG PIN A0 TO INPUT


sensors.begin();          //START THE DALLAS TEMPERATURE LIBRARY


pinMode(turbid,INPUT);    // SETTING THE ANALOG INPUT PIN OF TURBIDITY SENSOR TO INPPUT MODE


pinMode(USLED,OUTPUT);    // SETTING THE LED PIN TO OUTPUT MODE
pinMode(PHLED,OUTPUT);    // SETTING THE LED PIN TO OUTPUT MODE
pinMode(TEMPLED,OUTPUT);  // SETTING THE LED PIN TO OUTPUT MODE
pinMode(TURBLED,OUTPUT);  // SETTING THE LED PIN TO OUTPUT MODE


}



void loop() {



                    // LOOP CODE FOR ULTRASONIC SENSOR

digitalWrite(trigpin,LOW);   // SET THE TRIGGER PIN TO LOWER STATE
delayMicroseconds(2000);     // PAUSE BRIEFLY THE LOWER STATE OF TRIGGER PIN
digitalWrite(trigpin,HIGH);  // SET THE TRIGGER PIN TO HIGHER STATE
delayMicroseconds(15);       // PAUSE BRIEFLY THE HIGHER STATE OF TRIGGER PIN
digitalWrite(trigpin,LOW);   // SET THE TRIGGER PIN TO LOWER STATE

pulsetime=pulseIn(echopin,HIGH);  // SET THE ECHOPIN TO HIGHER STATE SO THAT IT CAN RECEIVE THE
                                  // TOTAL TIME OF THE PULSE AND STORE IT IN THE VARIABLE 'pulsetime'.

depth =((0.0344*pulsetime)/2+1.8);   // FORMULA FOR FINDING DISTANCE (S=VT), DIVIDING BY "2" HERE BECAUSE
                               // THE PULSE TIME IS FOR THE DISTANCE OF BOTH - TRANSMISSION AND RECEPTION


/*
 * THE FOLLOWING IF/ELSE STATEMENT TURNS THE 'USLED' ON OR OFF ACCORDING TO THE LIMIT VALUES GIVEN BY THE USER
 */
if(depth> 13){      // FOR LOWER LIMIT
  digitalWrite(USLED,HIGH);
}
else{                // FOR UPPER LIMIT
  if(depth<2.0)
  digitalWrite(USLED,HIGH);
  else{
    digitalWrite(USLED,LOW);
    }
  }




                    // LOOP CODE FOR PH SENSOR

 for(int i=0; i<50; i++){
    array1[i]=analogRead(pH);     //  READ 50 VALUES FROM THE ANALOG PIN A0 AND STORE IT IN THE ARRAY1
    delay(10);                    // HAVE A PAUSE OF 10 MILISCONDS AFTER EACH VALUE OF ANALOG INPUT IS READ
}

               
 float sum=0;                     // CREATE A FLOAT VARIABLE FOR ADDING THE ANALOG VALUES


 for(int j=0;j<50;j++){
  sum = sum +  array1[j];         // ALL THE ANALOG INPUT VALUES READ WILL BE ADDED IN THE VARIABLE "sum" 
}


avgvalue = sum/50.0;               // THE VARIABLE 'avgvalue' STORES THE MEAN OF 100 VALUES
convertor = avgvalue*4.0/1023.0;     // CONVERT THE ANALOG READING TO 0-5 V RANGE
pHvalue = -5.7*convertor + 21.62;  // FORMULA TO CONVERT VOLTAGE INTO PH 





/*
 * THE FOLLOWING IF/ELSE STATEMENT TURNS THE 'PHLED' ON OR OFF ACCORDING TO THE LIMIT VALUES GIVEN BY THE USER
 */

if(pHvalue<4){
  digitalWrite(PHLED,HIGH);
}
else{
  if(pHvalue>8)
  digitalWrite(PHLED,HIGH);
  else{
    digitalWrite(PHLED,LOW);
    }
  }




                    // LOOP CODE FOR TEMPERATURE SENSOR
                    

sensors.requestTemperatures();           // SEND THE CCOMMAND TO GET TEMPERATURE READINGS
tempvalue = sensors.getTempCByIndex(0);  // GET THE VALUE OF TEMPERAURE IN CELCIUS. BY INDEX '0' REFERS TO THE FIRST IC OF THE WIRE


/*
 * THE FOLLOWING IF/ELSE STATEMENT TURNS THE 'TEMPLED' ON OR OFF ACCORDING TO THE LIMIT VALUES GIVEN BY THE USER
 */
if(tempvalue<20.0){
  digitalWrite(TEMPLED,HIGH);
}
else{
  if(tempvalue>30.0)
  digitalWrite(TEMPLED,HIGH);
  else{
    digitalWrite(TEMPLED,LOW);
    }
  }





                    // LOOP CODE FOR TURBIDITY SENSOR



/*
 * THE FOLLOWING FOR LOOP IS USED FOR STORING THE ANALOG INPUT VALUES FROM THE SENSOR TO THE "array2"
 */
for(int i=0; i<5; i++){
  array2[i] = analogRead(turbid);
}


/*
 * THE FOLLOWING FOR LOOP IS USED TO ADD ALL THE ARRAY VALUES AND STORE IT IN THE VARIABLE "SUM"
 */
float sum2=0;
for(int j=0; j<5; j++){
  sum2 = sum2 + array2[j];
}


float avg=sum2/5.0;                                                       // CALCULATE THE AVERAGE VALUE
float convert = avg*5.0/1023.0;                                           // CONVERT THE ANALOG VALUE TO 0-5V RANGE
float NTU = -1120.4*(convert)*(convert) + 5742.3*(convert) - 4352.9;      // CONVERT THE 0-5V VOLTAGE INTO NTUs


/*
 * THE FOLLOWING IF/ELSE STATEMENT IS USED TO TURN ON THE LED IF TURBDITY VALUE EXCEEDS
 */
if(NTU>2500){
  digitalWrite(TURBLED,LOW);
}
Serial.println(NTU);







                                       // LCD DISPLAY OF SENSOR VALUES


                    
                    // FOR DEPTH MEASUREMENT
                    
LCD.setCursor(0,0);     // SET THE CURSOR OF THE LCD DISPLAY TO THE FIRST COLUMN AND FIRST ROW
LCD.print(depth);       // DISPLAY THE VALUE OF DISTANCE ON THE LCD
LCD.setCursor(4,0);     // SET THE CURSOR OF THEE LCD DISPLAY TO THE FIFTH COLUMN AND FIRST ROW
LCD.print(" cm");       // DISPLAY THE UNITS OF DEPTH "CM"
delay(100);             // DELAY THE DISPLAY FOR 200 MILISECONDS SO THAT THE VALUE OF DEPTH CAN BE READ CONVENIENTLY



                    // FOR PH MEASUREMENT
                    
LCD.setCursor(9,0);     // SET THE CURSOR OF THE LCD DISPLAY TO THE TENTH COLUMN AND FIRST ROW
LCD.print(pHvalue);     // DISPLAY THE VALUE OF PH ON THE LCD
LCD.setCursor(13,0);    // SET THE CURSOR OF THE LCD DISPLAY TO THE FOURTEENTH COLUMN AND FIRST ROW
LCD.print(" PH");       // DISPLAY "PH" ON THE LCD SCREEN
delay(100);



                    // FOR TEMPERATURE MEASUREMENT 
                    
LCD.setCursor(0,1);     // SET THE CURSOR OF THE LCD DISPLAY TO THE FIRST COLUMN AND SECOND ROW
LCD.print(tempvalue);   // DISPLAY THE VALUE OF TEMPERATURE ON THE LCD
LCD.setCursor(4,1);     // SET THE CURSOR OF THE LCD DISPLAY TO THE FIFTH COLUMN AND SECOND ROW
LCD.print(" ");         // DISPLAY A BLANK SPACE ON THE LCD SCREEN                 
LCD.print((char)223);   // DISPLAY "°" ON THE LCD SCREEN
LCD.print("C");         // DISPLAY "C" ON THE LCD SCREEN
delay(100);



                    // FOR TURBDIDTY MEASUREMENT
LCD.setCursor(9,1);     // SET THE CURSOR OF THE LCD DISPLAY TO THE TENTH COLUMN AND SECOND ROW
// LCD.print(NTU);         // DISPLAY THE VALUE OF TURBIDITY ON THE LCD
LCD.print("ERROR");     // PRINT "ERROR" MESSAGE IF THE TURBIDITY SENSOR IS NOT WORKING
delay(100);






}
